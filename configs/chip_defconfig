## configs/chip_defconfig
```kconfig
BR2_HAVE_DOT_CONFIG=y
BR2_HOSTARCH_NEEDS_IA32_LIBS=y
BR2_arm=y
BR2_ARCH="arm"
BR2_ENDIAN="LITTLE"
BR2_GCC_TARGET_ABI="aapcs-linux"
BR2_GCC_TARGET_CPU="cortex-a8"
BR2_GCC_TARGET_FPU="vfpv3-d16"
BR2_GCC_TARGET_FLOAT_ABI="hard"
BR2_GCC_TARGET_MODE="arm"
BR2_ARCH_HAS_ATOMICS=y
BR2_BINFMT_SUPPORTS_SHARED=y
BR2_BINFMT_ELF=y
BR2_ARM_CPU_HAS_NEON=y
BR2_ARM_CPU_HAS_VFPV2=y
BR2_ARM_CPU_HAS_VFPV3=y
BR2_ARM_CPU_HAS_ARM=y
BR2_ARM_CPU_HAS_THUMB2=y
BR2_ARM_CPU_ARMV7A=y
BR2_cortex_a8=y
BR2_ARM_EABIHF=y
BR2_ARM_FPU_VFPV3D16=y
BR2_ARM_INSTRUCTIONS_ARM=y
BR2_WGET="wget --passive-ftp -nd -t 3"
BR2_SVN="svn"
BR2_BZR="bzr"
BR2_GIT="git"
BR2_CVS="cvs"
BR2_LOCALFILES="cp"
BR2_SCP="scp"
BR2_SSH="ssh"
BR2_HG="hg"
BR2_ZCAT="gzip -d -c"
BR2_BZCAT="bzcat"
BR2_XZCAT="xzcat"
BR2_TAR_OPTIONS=""
BR2_DEFCONFIG="$(CONFIG_DIR)/defconfig"
BR2_DL_DIR="$(TOPDIR)/dl"
BR2_HOST_DIR="$(BASE_DIR)/host"
BR2_PRIMARY_SITE=""
BR2_BACKUP_SITE="http://sources.buildroot.net/"
BR2_KERNEL_MIRROR="http://www.kernel.org/pub/"
BR2_GNU_MIRROR="http://ftp.gnu.org/pub/gnu"
BR2_LUAROCKS_MIRROR="http://luarocks.org/repositories/rocks"
BR2_CPAN_MIRROR="http://search.cpan.org/CPAN"
BR2_JLEVEL=0
BR2_STRIP_strip=y
BR2_STRIP_EXCLUDE_FILES=""
BR2_STRIP_EXCLUDE_DIRS=""
BR2_OPTIMIZE_S=y
BR2_SHARED_LIBS=y
BR2_PACKAGE_OVERRIDE_FILE="$(TOPDIR)/local.mk"
BR2_GLOBAL_PATCH_DIR=""
BR2_TOOLCHAIN=y
BR2_TOOLCHAIN_USES_GLIBC=y
BR2_TOOLCHAIN_EXTERNAL=y
BR2_TOOLCHAIN_EXTERNAL_LINARO_ARM=y
BR2_TOOLCHAIN_EXTERNAL_DOWNLOAD=y
BR2_TOOLCHAIN_EXTERNAL_PREFIX="arm-linux-gnueabihf"
BR2_TOOLCHAIN_EXTERNAL_GLIBC=y
BR2_TOOLCHAIN_HAS_NATIVE_RPC=y
BR2_USE_WCHAR=y
BR2_ENABLE_LOCALE=y
BR2_INSTALL_LIBSTDCPP=y
BR2_TOOLCHAIN_HAS_THREADS=y
BR2_TOOLCHAIN_HAS_THREADS_DEBUG=y
BR2_TOOLCHAIN_HAS_THREADS_NPTL=y
BR2_TOOLCHAIN_HAS_SHADOW_PASSWORDS=y
BR2_TOOLCHAIN_HAS_SSP=y
BR2_GENERATE_LOCALE=""
BR2_USE_MMU=y
BR2_TARGET_OPTIMIZATION="-pipe"
BR2_TARGET_LDFLAGS=""
BR2_TOOLCHAIN_HEADERS_AT_LEAST_3_0=y
BR2_TOOLCHAIN_HEADERS_AT_LEAST_3_1=y
BR2_TOOLCHAIN_HEADERS_AT_LEAST="3.1"
BR2_TARGET_GENERIC_HOSTNAME="buildroot"
BR2_TARGET_GENERIC_ISSUE="Welcome to Buildroot"
BR2_TARGET_GENERIC_PASSWD_MD5=y
BR2_TARGET_GENERIC_PASSWD_METHOD="md5"
BR2_INIT_BUSYBOX=y
BR2_ROOTFS_DEVICE_CREATION_DYNAMIC_DEVTMPFS=y
BR2_ROOTFS_DEVICE_TABLE="system/device_table.txt"
BR2_ROOTFS_SKELETON_DEFAULT=y
BR2_TARGET_GENERIC_ROOT_PASSWD=""
BR2_SYSTEM_BIN_SH_BUSYBOX=y
BR2_SYSTEM_BIN_SH="/bin/busybox"
BR2_TARGET_GENERIC_GETTY=y
BR2_TARGET_GENERIC_GETTY_PORT="console"
BR2_TARGET_GENERIC_GETTY_BAUDRATE_115200=y
BR2_TARGET_GENERIC_GETTY_BAUDRATE="115200"
BR2_TARGET_GENERIC_GETTY_TERM="vt100"
BR2_TARGET_GENERIC_GETTY_OPTIONS=""
BR2_TARGET_GENERIC_REMOUNT_ROOTFS_RW=y
BR2_SYSTEM_DHCP=""
BR2_ROOTFS_USERS_TABLES=""
BR2_ROOTFS_OVERLAY=""
BR2_ROOTFS_POST_BUILD_SCRIPT=""
BR2_ROOTFS_POST_IMAGE_SCRIPT=""
BR2_LINUX_KERNEL=y
BR2_LINUX_KERNEL_CUSTOM_GIT=y
BR2_LINUX_KERNEL_CUSTOM_REPO_URL="https://github.com/NextThingCo/CHIP-linux.git"
BR2_LINUX_KERNEL_CUSTOM_REPO_VERSION="7420f11"
BR2_LINUX_KERNEL_PATCH="wext_priv.patch"
BR2_LINUX_KERNEL_USE_CUSTOM_CONFIG=y
BR2_LINUX_KERNEL_CUSTOM_CONFIG_FILE="board/nextthing/chip/linux.config"
BR2_LINUX_KERNEL_ZIMAGE=y
BR2_LINUX_KERNEL_DTS_SUPPORT=y
BR2_LINUX_KERNEL_USE_INTREE_DTS=y
BR2_LINUX_KERNEL_INTREE_DTS_NAME="sun5i-r8-chip"
BR2_LINUX_KERNEL_INSTALL_TARGET=y
BR2_PACKAGE_BUSYBOX=y
BR2_PACKAGE_BUSYBOX_CONFIG="package/busybox/busybox.config"
BR2_PACKAGE_BUSYBOX_SHOW_OTHERS=y
BR2_PACKAGE_KODI_ARCH_SUPPORTS=y
BR2_PACKAGE_MPLAYER_ARCH_SUPPORTS=y
BR2_PACKAGE_GOOGLE_BREAKPAD_ARCH_SUPPORTS=y
BR2_PACKAGE_RTL8723BS=y
BR2_PACKAGE_RTL8723BS_CUSTOM_GIT=y
BR2_PACKAGE_RTL8723BS_CUSTOM_REPO_URL="https://github.com/hadess/rtl8723bs.git"
BR2_PACKAGE_RTL8723BS_CUSTOM_REPO_VERSION="master"
BR2_PACKAGE_RTL8723BS_VERSION="master"
BR2_PACKAGE_CMAKE_ARCH_SUPPORTS=y
BR2_PACKAGE_MMC_UTILS=y
BR2_PACKAGE_MTD=y
BR2_PACKAGE_MTD_FLASHCP=y
BR2_PACKAGE_MTD_FLASH_ERASE=y
BR2_PACKAGE_MTD_FLASH_LOCK=y
BR2_PACKAGE_MTD_FLASH_UNLOCK=y
BR2_PACKAGE_MTD_MKFSUBIFS=y
BR2_PACKAGE_MTD_MTD_DEBUG=y
BR2_PACKAGE_MTD_NANDDUMP=y
BR2_PACKAGE_MTD_NANDTEST=y
BR2_PACKAGE_MTD_NANDWRITE=y
BR2_PACKAGE_MTD_MTDINFO=y
BR2_PACKAGE_MTD_UBIATTACH=y
BR2_PACKAGE_MTD_UBICRC32=y
BR2_PACKAGE_MTD_UBIDETACH=y
BR2_PACKAGE_MTD_UBIFORMAT=y
BR2_PACKAGE_MTD_UBIMKVOL=y
BR2_PACKAGE_MTD_UBINFO=y
BR2_PACKAGE_MTD_UBINIZE=y
BR2_PACKAGE_MTD_UBIRENAME=y
BR2_PACKAGE_MTD_UBIRMVOL=y
BR2_PACKAGE_MTD_UBIRSVOL=y
BR2_PACKAGE_MTD_UBIUPDATEVOL=y
BR2_PACKAGE_MTD_UBIBLOCK=y
BR2_PACKAGE_QT5_JSCORE_AVAILABLE=y
BR2_PACKAGE_DBUS=y
BR2_PACKAGE_I2C_TOOLS=y
BR2_PACKAGE_LSHW=y
BR2_PACKAGE_LSUIO=y
BR2_PACKAGE_PCIUTILS=y
BR2_PACKAGE_LUAJIT_ARCH_SUPPORTS=y
BR2_PACKAGE_MONO_ARCH_SUPPORTS=y
BR2_PACKAGE_LZO=y
BR2_PACKAGE_ZLIB=y
BR2_PACKAGE_BOTAN_ARCH_SUPPORTS=y
BR2_PACKAGE_GNUTLS=y
BR2_PACKAGE_NETTLE=y
BR2_PACKAGE_WEBKIT_ARCH_SUPPORTS=y
BR2_PACKAGE_EXPAT=y
BR2_PACKAGE_CANFESTIVAL_ARCH_SUPPORTS=y
BR2_PACKAGE_LIBNL=y
BR2_PACKAGE_LIBPCAP=y
BR2_PACKAGE_BOOST_ARCH_SUPPORTS=y
BR2_PACKAGE_GMP=y
BR2_PACKAGE_LIBATOMIC_ARCH_SUPPORTS=y
BR2_PACKAGE_LIBBSD_ARCH_SUPPORTS=y
BR2_PACKAGE_LIBFFI=y
BR2_PACKAGE_LIBGLIB2=y
BR2_PACKAGE_LIBICAL=y
BR2_PACKAGE_LIBNSPR_ARCH_SUPPORT=y
BR2_PACKAGE_NCURSES=y
BR2_PACKAGE_PCRE=y
BR2_PACKAGE_PCRE_UTF=y
BR2_PACKAGE_PCRE_UCP=y
BR2_PACKAGE_READLINE=y
BR2_PACKAGE_BLUEZ5_UTILS=y
BR2_PACKAGE_BLUEZ5_UTILS_OBEX=y
BR2_PACKAGE_BLUEZ5_UTILS_CLIENT=y
BR2_PACKAGE_BLUEZ5_UTILS_GATTTOOL=y
BR2_PACKAGE_BLUEZ5_UTILS_EXPERIMENTAL=y
BR2_PACKAGE_BLUEZ5_UTILS_TEST=y
BR2_PACKAGE_CONNMAN=y
BR2_PACKAGE_CONNMAN_ETHERNET=y
BR2_PACKAGE_CONNMAN_WIFI=y
BR2_PACKAGE_CONNMAN_WISPR=y
BR2_PACKAGE_CONNMAN_BLUETOOTH=y
BR2_PACKAGE_CONNMAN_CLIENT=y
BR2_PACKAGE_IPERF3=y
BR2_PACKAGE_IPROUTE2=y
BR2_PACKAGE_IPTABLES=y
BR2_PACKAGE_IW=y
BR2_PACKAGE_TCPDUMP=y
BR2_PACKAGE_WPA_SUPPLICANT=y
BR2_PACKAGE_WPA_SUPPLICANT_AP_SUPPORT=y
BR2_PACKAGE_WPA_SUPPLICANT_EAP=y
BR2_PACKAGE_WPA_SUPPLICANT_HOTSPOT=y
BR2_PACKAGE_WPA_SUPPLICANT_DEBUG_SYSLOG=y
BR2_PACKAGE_WPA_SUPPLICANT_CLI=y
BR2_PACKAGE_WPA_SUPPLICANT_DBUS_NEW=y
BR2_PACKAGE_WPA_SUPPLICANT_DBUS_INTROSPECTION=y
BR2_PACKAGE_KMOD=y
BR2_PACKAGE_KMOD_TOOLS=y
BR2_PACKAGE_SYSTEMD_ARCH_SUPPORTS=y
BR2_PACKAGE_UTIL_LINUX=y
BR2_PACKAGE_UTIL_LINUX_LIBUUID=y
BR2_TARGET_ROOTFS_CPIO=y
BR2_TARGET_ROOTFS_CPIO_NONE=y
BR2_TARGET_ROOTFS_UBIFS=y
BR2_TARGET_ROOTFS_UBIFS_LEBSIZE=0x1f8000
BR2_TARGET_ROOTFS_UBIFS_MINIOSIZE=0x4000
BR2_TARGET_ROOTFS_UBIFS_MAXLEBCNT=2000
BR2_TARGET_ROOTFS_UBIFS_LZO=y
BR2_TARGET_ROOTFS_UBIFS_OPTS=""
BR2_TARGET_ROOTFS_UBI=y
BR2_TARGET_ROOTFS_UBI_PEBSIZE=0x200000
BR2_TARGET_ROOTFS_UBI_SUBSIZE=16384
BR2_TARGET_ROOTFS_UBI_OPTS=""
BR2_TARGET_UBOOT=y
BR2_TARGET_UBOOT_BOARDNAME="CHIP"
BR2_TARGET_UBOOT_CUSTOM_GIT=y
BR2_TARGET_UBOOT_CUSTOM_REPO_URL="https://github.com/NextThingCo/CHIP-u-boot.git"
BR2_TARGET_UBOOT_CUSTOM_REPO_VERSION="6198e31"
BR2_TARGET_UBOOT_FORMAT_CUSTOM=y
BR2_TARGET_UBOOT_FORMAT_CUSTOM_NAME="u-boot-dtb.bin"
BR2_TARGET_UBOOT_SPL=y
BR2_TARGET_UBOOT_SPL_NAME="spl/sunxi-spl.bin"
BR2_PACKAGE_HOST_SUNXI_TOOLS=y
BR2_PACKAGE_TZDATA_ZONELIST=""
BR2_TARGET_UBOOT_CUSTOM_GIT_REPO_URL=""
BR2_TARGET_UBOOT_CUSTOM_GIT_VERSION=""
BR2_LINUX_KERNEL_CUSTOM_GIT_REPO_URL=""
BR2_LINUX_KERNEL_CUSTOM_GIT_VERSION=""
```

## fs/initramfs/Config.in
```kconfig
config BR2_TARGET_ROOTFS_INITRAMFS
	bool "initial RAM filesystem linked into linux kernel"
	depends on BR2_LINUX_KERNEL
	help
	  Integrate a cpio archive as an initramfs inside the kernel
	  image. This integration will take place automatically.

if BR2_TARGET_ROOTFS_INITRAMFS

choice
	prompt "Initramfs cpio archive"
	default BR2_INITRAMFS_USE_ROOTFS
	help
	  To accomodate for various scenarios when used for initial
	  RAM filesystem, different options for creation are
	  available.

config BR2_INITRAMFS_USE_ROOTFS
	bool "generate from root filesystem"
	select BR2_TARGET_ROOTFS_CPIO
	help
	  A rootfs.cpio file will be generated in the images/ directory.
	  This is the archive that will be included in the kernel image.
	  The default rootfs compression set in the kernel configuration
	  is used, regardless of how buildroot's cpio archive is configured.

	  Note that enabling initramfs together with another filesystem
	  formats doesn't make sense: you would end up having two
	  identical root filesystems, one embedded inside the kernel
	  image, and one separately.


config BR2_INITRAMFS_USE_OTHER
	bool "generate separately"
	help
	  It is assumed that the cpio archive is generated externally 
	  and will be present at images/rootfs.cpio when it is needed.

	  This option may be used with a post-build hook to generate 
	  and use an initial RAM filesystem that is not the same as
	  root filesystem.

	  The compression options for the cpio archive must be set
	  separately in the kernel configuration according to the 
	  compression used for the externally generated cpio archive.

	  Note that using this option along with cpio archive filesytem
	  target is the same as selecting the "create from root 
	  filesystem" option.
	  
endchoice

choice
	prompt "Compression method"
	default BR2_CPIO_COMPRESSION_NONE
	help
	  Select compressor for cpio filesystem of the root filesystem.
	  If you use the cpio archive as an initial RAM filesystem, make
	  sure the kernel contains the decompression algorithm selected
	  here.

config BR2_CPIO_COMPRESSION_NONE
	bool "no compression"
	help
	  Do not compress the cpio filesystem.

config BR2_CPIO_COMPRESSION_GZIP
	bool "gzip"
	help
	  Do compress the cpio filesystem with gzip.

config BR2_CPIO_COMPRESSION_BZIP2
	bool "bzip2"
	help
	  Do compress the cpio filesystem with bzip2.

config BR2_CPIO_COMPRESSION_LZMA
	bool "lzma"
	help
	  Do compress the cpio filesystem with lzma.

config BR2_CPIO_COMPRESSION_LZO
	bool "lzo"
	help
	  Do compress the cpio filesystem with lzop.

config BR2_CPIO_COMPRESSION_XZ
	bool "xz"
	help
	  Do compress the cpio filesystem with xz.

config BR2_CPIO_COMPRESSION_LZ4
	bool "lz4"
	help
	  Do compress the cpio filesystem with lz4.

endchoice

if BR2_INITRAMFS_USE_OTHER

endif # BR2_INITRAMFS_USE_OTHER

endif # BR2_TARGET_ROOTFS_INITRAMFS

config BR2_CPIO_COMPRESSION
	string
	default "" if BR2_CPIO_COMPRESSION_NONE
	default "gz" if BR2_CPIO_COMPRESSION_GZIP
	default "bz2" if BR2_CPIO_COMPRESSION_BZIP2
	default "lzma" if BR2_CPIO_COMPRESSION_LZMA
	default "lzo" if BR2_CPIO_COMPRESSION_LZO
	default "xz" if BR2_CPIO_COMPRESSION_XZ
	default "lz4" if BR2_CPIO_COMPRESSION_LZ4

config BR2_CPIO_COMPRESSED_FILE
	string
	default "rootfs.cpio" if BR2_CPIO_COMPRESSION_NONE
	default "rootfs.cpio.gz" if BR2_CPIO_COMPRESSION_GZIP
	default "rootfs.cpio.bz2" if BR2_CPIO_COMPRESSION_BZIP2
	default "rootfs.cpio.lzma" if BR2_CPIO_COMPRESSION_LZMA
	default "rootfs.cpio.lzo" if BR2_CPIO_COMPRESSION_LZO
	default "rootfs.cpio.xz" if BR2_CPIO_COMPRESSION_XZ
	default "rootfs.cpio.lz4" if BR2_CPIO_COMPRESSION_LZ4

comment "initramfs needs a Linux kernel to be built"
	depends on !BR2_LINUX_KERNEL
```

## fs/isoroot/Config.in
```kconfig
config BR2_TARGET_ROOTFS_ISOROOT
	bool "isofs root filesystem for the target device"
	depends on BR2_PACKAGE_UBI_IMAGE || BR2_PACKAGE_SD_IMAGE
	help
	  Build a isofs root filesystem
```

## package/cloop/Config.in.host
```kconfig
config BR2_PACKAGE_HOST_CLOOP
	bool "cloop"
	help
		compressed loop (cloop) tools
```

## package/sudo/Config.in
```kconfig
config BR2_PACKAGE_SUDO
	bool "sudo"
	# uses fork()
	depends on BR2_USE_MMU
	help
	  Sudo is a program designed to allow a sysadmin to give
	  limited root privileges to users and log root activity. The
	  basic philosophy is to give as few privileges as possible
	  but still allow people to get their work done.

	  http://www.sudo.ws/sudo/

if BR2_PACKAGE_SUDO

config BR2_SUDO_ENABLE_SUDO_GROUP
	bool "Enable sudo for sudo group"
	help
	  Modify /etc/sudoers to enable sudo for members of sudo group

endif # BR2_PACKAGE_SUDO
```
